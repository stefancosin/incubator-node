## main/Kconfig.projbuild
```kconfig
menu "Incubator Node Configuration"

    config INCUBATOR_WIFI_SSID
        string "WiFi SSID"
        default "myssid"

    config INCUBATOR_WIFI_PASSWORD
        string "WiFi Password"
        default "mypassword"

    config INCUBATOR_MQTT_BROKER_URI
        string "MQTT broker URI"
        default "mqtt://192.168.1.67:1883"
        help
            Address of the Mosquitto broker on the RPi platform.

    config INCUBATOR_MQTT_CLIENT_ID
        string "MQTT client ID"
        default "incubator-node"

endmenu
```
